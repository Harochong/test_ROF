## light_bulb/build/Kconfig/Kconfig.shield
```kconfig
osource "c:/ncs/v2.4.2/nrf/samples/matter/light_bulb/boards/shields/*/Kconfig.shield"
osource "C:/ncs/v2.4.2/nrf/boards/shields/*/Kconfig.shield"
```

## light_bulb/build/Kconfig/Kconfig.shield.defconfig
```kconfig
osource "c:/ncs/v2.4.2/nrf/samples/matter/light_bulb/boards/shields/*/Kconfig.defconfig"
osource "C:/ncs/v2.4.2/nrf/boards/shields/*/Kconfig.defconfig"
```
